/*
 * Board : ESP32 Mini (ESP32-C3)
 * Display: 1.3" 128×64 SH1106 @ 0x3C
 * Library: Adafruit SH110X
 * Animations generated by OLED Display Animation Maker — https://www.oledanimationmaker.com/
 */

/*
 * WIRING
 * 
 * OLED Display
 *   GPIO8 - SDA
 *   GPIO9 - SCL/SCK
 *   3.3V - OLED VCC
 *   GND - OLED GND
 * 
 * Cuddle button
 *   GPIO0 / GND
 * 
 * Motion sensor
 *   GPIO1 / 5V / GND 
 */

/*
 * ALGORITHM
 * 
 * Display a random startup animation
 * Initialize sleepy timer
 * Initialize needcare timer
 * Initialize every-second-timer with dedicated ISR routine
 * Initialize motion sensor with dedicated ISR routine
 * Initialize cuddle button with dedicated ISR routine
 * state = HAPPY
 * loop()
 *   IF state == HAPPY
 *     Choose randomly a happy animation
 *     WHILE state == HAPPY && N fois
 *       Display happy animation
 *   IF state == SLEEPY
 *     Choose randomly a sleepy animation
 *     WHILE state == SLEEPY
 *       Display sleepy animation
 *   IF state == NEEDCARE
 *     Choose randomly a needcare animation
 *     WHILE state == NEEDY
 *       Display needcare animation
 *   IF state == LOVY
 *     Choose randomly a love animation
 *       Display love animation
 *     state = HAPPY
 *
 * every_second_timer() & ISR()
 *   Increment sleepy timer
 *   Increment needcare timer
 *   IF sleepy timer reached && state == HAPPY
 *     state = SLEEPY
 *   IF needcare timer reached
 *     state = NEEDY
 *
 * motionISR()
 *   IF state == SLEEPY
 *     Reset sleepy timer
 *     state = HAPPY
 *
 * buttonISR()
 *   Reset sleepy timer
 *   Reset needcare timer
 *   state = LOVY
 *
 */

#include <Wire.h>
#include <Adafruit_GFX.h>
#include <Adafruit_SH110X.h>

#include "tamafrogi_startup.h"
#include "tamafrogi_happy1.h"
#include "tamafrogi_happy2.h"
#include "tamafrogi_happy3.h"
#include "tamafrogi_happy4.h"
#include "tamafrogi_happy5.h"
#include "tamafrogi_happy6.h"
#include "tamafrogi_happy7.h"
#include "tamafrogi_happy8.h"
#include "tamafrogi_happy9.h"
#include "tamafrogi_happy10.h"
#include "tamafrogi_happy11.h"
#include "tamafrogi_happy12.h"
#include "tamafrogi_happy13.h"
#include "tamafrogi_happy14.h"
#include "tamafrogi_happy15.h"
#include "tamafrogi_happy16.h"
#include "tamafrogi_happy17.h"
#include "tamafrogi_happy18.h"
#include "tamafrogi_happy19.h"
#include "tamafrogi_happy20.h"
#include "tamafrogi_happy21.h"
#include "tamafrogi_happy22.h"
#include "tamafrogi_happy23.h"
#include "tamafrogi_love1.h"
#include "tamafrogi_love2.h"
#include "tamafrogi_love3.h"
#include "tamafrogi_love4.h"
#include "tamafrogi_love5.h"
#include "tamafrogi_love6.h"
#include "tamafrogi_need1.h"
#include "tamafrogi_need2.h"
#include "tamafrogi_need3.h"
#include "tamafrogi_need4.h"
#include "tamafrogi_need5.h"
#include "tamafrogi_need6.h"
#include "tamafrogi_need7.h"
#include "tamafrogi_need8.h"
#include "tamafrogi_need9.h"
#include "tamafrogi_need10.h"
#include "tamafrogi_sleep1.h"
#include "tamafrogi_sleep2.h"
#include "tamafrogi_sleep3.h"
#include "tamafrogi_sleep4.h"
#include "tamafrogi_sleep5.h"
#include "tamafrogi_sleep6.h"
#include "tamafrogi_sleep7.h"

// Display settings
#define SCREEN_WIDTH  128
#define SCREEN_HEIGHT 64
#define OLED_RESET    -1
#define SCREEN_ADDR   0x3C

// Motion sensor settings
// D3 pin
#define motionSensor 1

// Cuddle button settings
// D2 pin
#define cuddleButton 0

// Finite-state automaton settings
enum frogi_states { HAPPY, SLEEPY, NEEDY, LOVY };
frogi_states frogi_state = HAPPY;
// PROD
//#define DELAY_SLEEPY_SEC 300
//#define DELAY_NEEDY_SEC 3600
//#define HAPPY_ANIM_DISPLAY_TIMES 30
// DEBUG
#define DELAY_SLEEPY_SEC 10
#define DELAY_NEEDY_SEC 30
#define HAPPY_ANIM_DISPLAY_TIMES 5


// Constants for animations
const uint8_t** anim_happy_all_frames[] = {anim_happy1_frames, anim_happy2_frames, anim_happy3_frames, anim_happy4_frames, anim_happy5_frames, anim_happy6_frames, anim_happy7_frames, anim_happy8_frames, anim_happy9_frames, anim_happy10_frames, anim_happy11_frames, anim_happy12_frames, anim_happy13_frames, anim_happy14_frames, anim_happy15_frames, anim_happy16_frames, anim_happy17_frames, anim_happy18_frames, anim_happy19_frames, anim_happy20_frames, anim_happy21_frames, anim_happy22_frames, anim_happy23_frames};
const uint8_t anim_happy_all_numFrames[] = {anim_happy1_numFrames, anim_happy2_numFrames, anim_happy3_numFrames, anim_happy4_numFrames, anim_happy5_numFrames, anim_happy6_numFrames, anim_happy7_numFrames, anim_happy8_numFrames, anim_happy9_numFrames, anim_happy10_numFrames, anim_happy11_numFrames, anim_happy12_numFrames, anim_happy13_numFrames, anim_happy14_numFrames, anim_happy15_numFrames, anim_happy16_numFrames, anim_happy17_numFrames, anim_happy18_numFrames, anim_happy19_numFrames, anim_happy20_numFrames, anim_happy21_numFrames, anim_happy22_numFrames, anim_happy23_numFrames};

const uint8_t** anim_lovy_all_frames[] = {anim_love1_frames, anim_love2_frames, anim_love3_frames, anim_love4_frames, anim_love5_frames, anim_love6_frames};
const uint8_t anim_lovy_all_numFrames[] = {anim_love1_numFrames, anim_love2_numFrames, anim_love3_numFrames, anim_love4_numFrames, anim_love5_numFrames, anim_love6_numFrames};

const uint8_t** anim_needy_all_frames[] = {anim_need1_frames, anim_need2_frames, anim_need3_frames, anim_need4_frames, anim_need5_frames, anim_need6_frames, anim_need7_frames, anim_need8_frames, anim_need9_frames, anim_need10_frames};
const uint8_t anim_needy_all_numFrames[] = {anim_need1_numFrames, anim_need2_numFrames, anim_need3_numFrames, anim_need4_numFrames, anim_need5_numFrames, anim_need6_numFrames, anim_need7_numFrames, anim_need8_numFrames, anim_need9_numFrames, anim_need10_numFrames};

const uint8_t** anim_sleepy_all_frames[] = {anim_sleep1_frames, anim_sleep2_frames, anim_sleep3_frames, anim_sleep4_frames, anim_sleep5_frames, anim_sleep6_frames, anim_sleep7_frames};
const uint8_t anim_sleepy_all_numFrames[] = {anim_sleep1_numFrames, anim_sleep2_numFrames, anim_sleep3_numFrames, anim_sleep4_numFrames, anim_sleep5_numFrames, anim_sleep6_numFrames, anim_sleep7_numFrames};

#define HAPPY_ANIM_NUMBER 23 // number of happy animations (tamafrogi_happy1, etc)
#define LOVY_ANIM_NUMBER 6 // number of lovy animations (tamafrogi_love1, etc)
#define NEEDY_ANIM_NUMBER 10 // number of need animations (tamafrogi_need1, etc)
#define SLEEPY_ANIM_NUMBER 7 // number of need animations (tamafrogi_sleep1, etc)


// global variables
hw_timer_t * timer = NULL;
unsigned int seconds_count_sleepy = 0;
unsigned int seconds_count_needy = 0;
uint8_t** frames;
uint8_t numFrames;
uint8_t current_happy_anim = 0;
uint8_t current_lovy_anim = 0;
uint8_t current_needy_anim = 0;
uint8_t current_sleepy_anim = 0;

Adafruit_SH1106G display(SCREEN_WIDTH, SCREEN_HEIGHT, &Wire, OLED_RESET);


// ------------ CODE ------------
void setup() {
  Serial.println(F("TAMAFROGI AWAKING"));
  
  // Serial init
  Serial.begin(9600);

  // Display init
  if (!display.begin(SCREEN_ADDR, true)) {
    Serial.println(F("SH1106 allocation failed"));
    for (;;);
  }
  display.setRotation(0);
  display.clearDisplay();
  display.display();
  Serial.println(F("Display initialized"));

  // Motion sensor init
  pinMode(motionSensor, INPUT_PULLUP);
  attachInterrupt(digitalPinToInterrupt(motionSensor), motionISR, RISING);
  Serial.println(F("Motion sensor initialized"));
  
  // Cuddle button init
  pinMode(cuddleButton, INPUT_PULLUP);
  digitalWrite(cuddleButton, HIGH); // avoid getting a fake button pressed just after attaching interrupt
  attachInterrupt(digitalPinToInterrupt(cuddleButton), buttonISR, FALLING);
  Serial.println(F("Cuddle button initialized"));
  
  // Timer init
  init_every_second_timer();

  // seed random with sensor pin
  //randomSeed(analogRead(1));

  // seed random with unconnected pin
  randomSeed(analogRead(5));

  // Startup animation
  disp_startup();
}

void loop() {
  uint8_t anim_count = 0;
  
  Serial.print(F("loop - ")); print_state();
  switch(frogi_state) {
    case HAPPY: {
      // display a happy animation a few times (then next loop will display another animation if still happy)
      choose_new_happy_anim();
      for(anim_count = 0; frogi_state == HAPPY && anim_count < HAPPY_ANIM_DISPLAY_TIMES; anim_count++) {
        disp_happy();
      }
      break;
    }
    case SLEEPY: {
      // display same animation while not awaken
      choose_new_sleepy_anim();
      while(frogi_state == SLEEPY) {
        disp_sleepy();
      }
      break;
    }
    case NEEDY: {
      // display same animation while not taken care of
      choose_new_needy_anim();
      while(frogi_state == NEEDY) {
        disp_needcare();
      }
      break;
    }
    case LOVY: {
      // display a love animation two times then become happy
      choose_new_lovy_anim();
      disp_love();
      disp_love();
      change_state(HAPPY);
      break;
    }
  }

  // avoid full cpu loops in unexpected cases
  delay(0.1);

}

// ---------------- //
// Display functions
// ---------------- //

void disp_anim(uint8_t* anim_frames[], uint8_t num_frames) {
  static uint8_t frameIdx = 0;
  for(frameIdx = 0; frameIdx < num_frames; frameIdx++) {
    display.clearDisplay();
    display.drawBitmap(0, 0, anim_frames[frameIdx], 128, 64, SH110X_WHITE);
    display.display();
    frameIdx = (frameIdx + 1) % num_frames;
    delay(133);
  }  
}

void disp_startup() {
  frames = (uint8_t**)anim_startup_frames;
  disp_anim(frames, anim_startup_numFrames);
}

void disp_happy() {

  frames = (uint8_t**)anim_happy_all_frames[current_happy_anim];
  numFrames = anim_happy_all_numFrames[current_happy_anim];
  disp_anim(frames, numFrames);
  //Serial.println(F("DISPLAY HAPPY ANIMATION")); delay(5000); // DEBUG
}

void disp_sleepy() {
  
  frames = (uint8_t**)anim_sleepy_all_frames[current_sleepy_anim];
  numFrames = anim_sleepy_all_numFrames[current_sleepy_anim];
  disp_anim(frames, numFrames);
  //Serial.println(F("DISPLAY SLEEPY ANIMATION")); delay(5000); // DEBUG
}

void disp_needcare() {
  frames = (uint8_t**)anim_needy_all_frames[current_needy_anim];
  numFrames = anim_needy_all_numFrames[current_needy_anim];
  
  disp_anim(frames, numFrames);
  //Serial.println(F("DISPLAY NEEDY ANIMATION")); delay(5000); // DEBUG
}

void disp_love() {
  frames = (uint8_t**)anim_lovy_all_frames[current_lovy_anim];
  numFrames = anim_lovy_all_numFrames[current_lovy_anim];
  
  disp_anim(frames, numFrames);
  //Serial.println("DISPLAY LOVY ANIMATION"); delay(5000); // DEBUG
}


// ---------------- //
// Finite-state automaton functions
// ---------------- //

void init_every_second_timer() {

  // Set timer frequency to 1Mhz
  timer = timerBegin(1000000);

  // Attach onTimer function to our timer.
  timerAttachInterrupt(timer, &onTimer);

  // Set alarm to call onTimer function every second (value in microseconds).
  // Repeat the alarm (third parameter) with unlimited count = 0 (fourth parameter).
  timerAlarm(timer, 1000000, true, 0);
  
}

// TIMER VECTOR, gets called once a second (depends on prescaler and match register)
void ARDUINO_ISR_ATTR onTimer()
{
  //Serial.println(F("every-second-ISR called"));
  seconds_count_sleepy++;
  seconds_count_needy++;
  if (seconds_count_sleepy >= DELAY_SLEEPY_SEC
      && frogi_state == HAPPY) {
    change_state(SLEEPY);
  }
  if (seconds_count_needy >= DELAY_NEEDY_SEC
      && frogi_state != NEEDY) {
    change_state(NEEDY);
  }
}

void change_state(frogi_states new_state) {
  frogi_state = new_state;
  print_state();
}

void print_state() {
  Serial.print(F("State "));
  switch(frogi_state) {
    case HAPPY: { Serial.println(F("HAPPY")); break; }
    case SLEEPY: { Serial.println(F("SLEEPY")); break; }
    case NEEDY: { Serial.println(F("NEEDY")); break; }
    case LOVY: { Serial.println(F("LOVY")); break; }
  }
  
}

// ---------------- //
// Motion sensor functions
// ---------------- //

void motionISR() {
  Serial.println(F("Motion detected"));
  seconds_count_sleepy = 0;
  if (frogi_state == SLEEPY) {
    change_state(HAPPY);
  }
}

// ---------------- //
// Cuddle button functions
// ---------------- //

void buttonISR() {
  Serial.println(F("Cuddle detected"));
  seconds_count_sleepy = 0;
  seconds_count_needy = 0;
  change_state(LOVY);
}

// ---------------- //
// Behavior functions
// ---------------- //
void choose_new_happy_anim() {
  Serial.println(F("Choose new happy anim"));
  uint8_t new_happy_anim = current_happy_anim;
  while(new_happy_anim == current_happy_anim) {
    new_happy_anim = random(0, HAPPY_ANIM_NUMBER);
  }
  current_happy_anim = new_happy_anim;
}

void choose_new_lovy_anim() {
  Serial.println(F("Choose new lovy anim"));
  uint8_t new_lovy_anim = current_lovy_anim;
  while(new_lovy_anim == current_lovy_anim) {
    new_lovy_anim = random(0, LOVY_ANIM_NUMBER);
  }
  current_lovy_anim = new_lovy_anim;
}

void choose_new_needy_anim() {
  Serial.println(F("Choose new needy anim"));
  uint8_t new_needy_anim = current_needy_anim;
  while(new_needy_anim == current_needy_anim) {
    new_needy_anim = random(0, NEEDY_ANIM_NUMBER);
  }
  current_needy_anim = new_needy_anim;
}

void choose_new_sleepy_anim() {
  Serial.println(F("Choose new sleepy anim"));
  uint8_t new_sleepy_anim = current_sleepy_anim;
  while(new_sleepy_anim == current_sleepy_anim) {
    new_sleepy_anim = random(0, SLEEPY_ANIM_NUMBER);
  }
  current_sleepy_anim = new_sleepy_anim;
}
